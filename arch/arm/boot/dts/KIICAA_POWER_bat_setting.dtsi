/*
 * Copyright (C) 2016 MediaTek Inc.
 *
 * This program is free software; you can redistribute it and/or modify
 * it under the terms of the GNU General Public License version 2 as
 * published by the Free Software Foundation.
 *
 * This program is distributed in the hope that it will be useful,
 * but WITHOUT ANY WARRANTY; without even the implied warranty of
 * MERCHANTABILITY or FITNESS FOR A PARTICULAR PURPOSE.
 * See http://www.gnu.org/licenses/gpl-2.0.html for more details.
 */

/*************************
 * Customized Battery Setting dtsi file
*************************/
&bat_comm {
			stop_charging_in_takling = <0x1>;
			talking_recharge_voltage = <0xed8>;
			talking_sync_time = <0x3c>;
			mtk_temperature_recharge_support = <0x1>;
			max_charge_temperature = <0x32>;
			max_charge_temperature_minus_x_degree = <0x2f>;
			min_charge_temperature = <0x0>;
			min_charge_temperature_plus_x_degree = <0x6>;
			err_charge_temperature = <0xff>;
			v_pre2cc_thres = <0xd48>;
			v_cc2topoff_thres = <0x10cc>;
			recharging_voltage = <0x10a4>;
			charging_full_current = <0xb4>;
			config_usb_if = <0x0>;
			usb_charger_current_suspend = <0x0>;
			usb_charger_current_unconfigured = <0x1b58>;
			usb_charger_current_configured = <0xc350>;
			usb_charger_current = <0xc350>;
			ac_charger_current = <0x249f0>;
			non_std_ac_charger_current = <0xc350>;
			charging_host_charger_current = <0xfde8>;
			apple_0_5a_charger_current = <0xc350>;
			apple_1_0a_charger_current = <0xfde8>;
			apple_2_1a_charger_current = <0x13880>;
			bat_low_temp_protect_enable = <0x0>;
			v_charger_enable = <0x0>;
			v_charger_max = <0x1964>;
			v_charger_min = <0x1130>;
			onehundred_percent_tracking_time = <0xa>;
			npercent_tracking_time = <0x14>;
			sync_to_real_tracking_time = <0x3c>;
			v_0percent_tracking = <0xd7a>;
			high_battery_voltage_support = <0x1>;
};

&bat_meter {
	/* cust_battery_meter.h */
	/* ADC resistor  */
	r_bat_sense = <4 >;
	r_i_sense = <4 >;
	r_charger_1 = <330 >;
	r_charger_2 = <39 >;
	temperature_t0 = <110 >;
	temperature_t1 = <0 >;
	temperature_t2 = <25 >;
	temperature_t3 = <50 >;
	temperature_t = <255 >;	/* this should be fixed, never change the value */
	fg_meter_resistance = <0 >;

	/* Qmax for 0mA */
			q_max_pos_50 = <0xf6e>;
			q_max_pos_25 = <0xf06>;
			q_max_pos_0 = <0xf5c>;
			q_max_neg_10 = <0xf40>;
	/* Qmax for 400mA, said high current */
			q_max_pos_50_h_current = <0xfab>;
			q_max_pos_25_h_current = <0xf39>;
			q_max_pos_0_h_current = <0xea9>;
			q_max_neg_10_h_current = <0xb42>;
	/* Discharge percentage, 1: D5, 0: D2 */
			oam_d5 = <0x0>;

	change_tracking_point = <1 >;
	/* SW OCV tracking setting */
	cust_tracking_point = <1 >;
			cust_r_sense = <0xdc>;
	cust_hw_cc = <0 >;
	aging_tuning_value = <103 >;
	cust_r_fg_offset = <0 >;
	ocv_board_compesate = <0 >;
	r_fg_board_base = <1000 >;
	r_fg_board_slope = <1000 >;
			car_tune_value = <0x64>;

	/* HW Fuel gague  */
	current_detect_r_fg = <10 >;	/* Unit: mA */
	minerroroffset = <1000 >;
	fg_vbat_average_size = <18 >;
	r_fg_value = <10 >;	/* Unit: mOhm */

			cust_poweron_delta_capacity_tolrance = <0x1e>;
	cust_poweron_low_capacity_tolrance = <5 >;
	cust_poweron_max_vbat_tolrance = <90 >;
	cust_poweron_delta_vbat_tolrance = <30 >;
	cust_poweron_delta_hw_sw_ocv_capacity_tolrance = <10 >;

	/* Fixed battery temperature */
	fixed_tbat_25 = <0 >;

	/* Dynamic change wake up period of battery thread when suspend */
	vbat_normal_wakeup = <3600 >;	/* Unit: mV */
	vbat_low_power_wakeup = <3500 >;	/* Unit: mV */
	normal_wakeup_period = <5400 >;	/* Unit: second */
	low_power_wakeup_period = <300 >;	/* Unit: second */
	close_poweroff_wakeup_period = <30 >;	/* Unit: second */

	rbat_pull_up_r = <16900 >;
	rbat_pull_up_volt = <1800 >;

	batt_temperature_table_num = <17 >;
	batt_temperature_table = <
	    (-20) 68237
	    (-15) 53650
	    (-10) 42506
	    (-5) 33892
	    0 27219
	    5 22021
	    10 17926
	    15 14674
	    20 12081
	    25 10000
	    30 8315
	    35 6948
	    40 5834
	    45 4917
	    50 4161
	    55 3535
	    60 3014
	>;

			battery_profile_t0_num = <0x4e>;
			battery_profile_t0 = <0x0 0x112e 0x1 0x1126 0x3 0x1110 0x4 0x10fa 0x5 0x10e5 0x7 0x10d2 0x8 0x10c0 0x9 0x10ae 0xb 0x109d 0xc 0x108c 0xd 0x107d 0xf 0x106c 0x10 0x105d 0x11 0x104e 0x13 0x103f 0x14 0x1030 0x15 0x1021 0x17 0x1016 0x18 0x100b 0x19 0xffe 0x1b 0xfed 0x1c 0xfd8 0x1d 0xfc1 0x1f 0xfab 0x20 0xf98 0x21 0xf89 0x23 0xf7c 0x24 0xf70 0x25 0xf67 0x27 0xf5e 0x28 0xf54 0x29 0xf4a 0x2b 0xf40 0x2c 0xf36 0x2d 0xf2d 0x2f 0xf25 0x30 0xf1c 0x31 0xf15 0x33 0xf0e 0x34 0xf07 0x35 0xf01 0x37 0xefb 0x38 0xef4 0x39 0xeef 0x3b 0xeea 0x3c 0xee6 0x3d 0xee2 0x3f 0xedf 0x40 0xedc 0x41 0xed9 0x43 0xed7 0x44 0xed5 0x45 0xed2 0x47 0xecf 0x48 0xecc 0x49 0xec9 0x4b 0xec5 0x4c 0xec2 0x4d 0xebd 0x4f 0xeb7 0x50 0xeb1 0x51 0xeaa 0x53 0xea3 0x54 0xe9c 0x55 0xe95 0x57 0xe8f 0x58 0xe89 0x59 0xe84 0x5b 0xe7e 0x5c 0xe79 0x5d 0xe71 0x5f 0xe67 0x60 0xe58 0x61 0xe49 0x62 0xe39 0x62 0xe28 0x63 0xe16 0x64 0xd48>;
			battery_profile_t1_num = <0x4e>;
			battery_profile_t1 = <0x0 0x1122 0x1 0x1111 0x3 0x1100 0x4 0x10f0 0x5 0x10e0 0x7 0x10d0 0x8 0x10c0 0x9 0x10b1 0xb 0x10a2 0xc 0x1093 0xd 0x1084 0xf 0x1076 0x10 0x1068 0x11 0x105a 0x13 0x104e 0x14 0x103f 0x15 0x1031 0x17 0x1023 0x18 0x1018 0x19 0x1007 0x1b 0xffa 0x1c 0xff0 0x1d 0xfe5 0x1f 0xfd8 0x20 0xfc6 0x21 0xfaf 0x23 0xf98 0x24 0xf84 0x25 0xf74 0x27 0xf67 0x28 0xf5c 0x29 0xf53 0x2b 0xf49 0x2c 0xf40 0x2d 0xf36 0x2f 0xf2f 0x30 0xf23 0x31 0xf1a 0x32 0xf13 0x34 0xf0a 0x35 0xf04 0x36 0xefd 0x38 0xef6 0x39 0xef0 0x3a 0xeea 0x3c 0xee5 0x3d 0xedf 0x3e 0xeda 0x40 0xed5 0x41 0xed0 0x42 0xecc 0x44 0xec8 0x45 0xec4 0x46 0xec1 0x48 0xebe 0x49 0xebc 0x4a 0xeb9 0x4c 0xeb6 0x4d 0xeb2 0x4e 0xead 0x50 0xea8 0x51 0xea1 0x52 0xe98 0x54 0xe8e 0x55 0xe84 0x56 0xe7b 0x58 0xe75 0x59 0xe71 0x5a 0xe6e 0x5c 0xe6a 0x5d 0xe66 0x5e 0xe5a 0x60 0xe40 0x61 0xe12 0x62 0xdcf 0x63 0xd6c 0x64 0xd48 0x64 0xd48>;
			battery_profile_t2_num = <0x4e>;
			battery_profile_t2 = <0x0 0x1124 0x1 0x1115 0x3 0x1107 0x4 0x10fa 0x5 0x10ea 0x7 0x10db 0x8 0x10cc 0x9 0x10bd 0xb 0x10ae 0xc 0x109f 0xe 0x1090 0xf 0x1081 0x10 0x1073 0x12 0x1064 0x13 0x1056 0x14 0x1048 0x16 0x103a 0x17 0x102b 0x18 0x101e 0x1a 0x1010 0x1b 0x1002 0x1c 0xff5 0x1e 0xfed 0x1f 0xfe3 0x21 0xfd0 0x22 0xfbc 0x23 0xfad 0x25 0xfa2 0x26 0xf99 0x27 0xf8c 0x29 0xf7d 0x2a 0xf6e 0x2b 0xf5f 0x2d 0xf51 0x2e 0xf46 0x2f 0xf3c 0x31 0xf34 0x32 0xf2b 0x34 0xf23 0x35 0xf1c 0x36 0xf16 0x38 0xf0f 0x39 0xf09 0x3a 0xf03 0x3c 0xefd 0x3d 0xef8 0x3e 0xef3 0x40 0xeed 0x41 0xee8 0x42 0xee3 0x44 0xede 0x45 0xeda 0x46 0xed5 0x48 0xed0 0x49 0xeca 0x4b 0xec5 0x4c 0xebf 0x4d 0xeb8 0x4f 0xeb2 0x50 0xeac 0x51 0xea6 0x53 0xe9b 0x54 0xe91 0x55 0xe85 0x57 0xe7a 0x58 0xe77 0x59 0xe76 0x5b 0xe75 0x5c 0xe74 0x5e 0xe71 0x5f 0xe69 0x60 0xe42 0x62 0xe10 0x63 0xdde 0x64 0xd84 0x64 0xd84 0x64 0xd84 0x64 0xd84>;
			battery_profile_t3_num = <0x4e>;
			battery_profile_t3 = <0x0 0x111f 0x1 0x1111 0x3 0x1106 0x4 0x10f8 0x5 0x10ea 0x7 0x10dc 0x8 0x10ce 0x9 0x10bf 0xb 0x10b0 0xc 0x10a1 0xd 0x1091 0xf 0x1083 0x10 0x1074 0x11 0x1065 0x13 0x1057 0x14 0x1048 0x15 0x1039 0x17 0x102b 0x18 0x101d 0x19 0x100f 0x1b 0x1001 0x1c 0xff3 0x1d 0xfe6 0x1f 0xfd9 0x20 0xfcc 0x21 0xfbf 0x22 0xfb3 0x24 0xfa7 0x25 0xf9c 0x26 0xf91 0x28 0xf85 0x29 0xf7a 0x2a 0xf6e 0x2c 0xf60 0x2d 0xf4f 0x2e 0xf3f 0x30 0xf33 0x31 0xf29 0x32 0xf20 0x34 0xf18 0x35 0xf10 0x36 0xf09 0x38 0xf02 0x39 0xefc 0x3a 0xef6 0x3c 0xeef 0x3d 0xeea 0x3e 0xee4 0x40 0xedf 0x41 0xeda 0x42 0xed5 0x44 0xed1 0x45 0xecc 0x46 0xec7 0x48 0xebf 0x49 0xeb6 0x4a 0xeb0 0x4c 0xeaa 0x4d 0xea4 0x4e 0xe9d 0x50 0xe97 0x51 0xe91 0x52 0xe8a 0x54 0xe80 0x55 0xe76 0x56 0xe6a 0x58 0xe5f 0x59 0xe5d 0x5a 0xe5c 0x5b 0xe5b 0x5d 0xe5a 0x5e 0xe57 0x5f 0xe49 0x61 0xe1e 0x62 0xddf 0x63 0xd85 0x64 0xd48 0x64 0xd48>;
			r_profile_t0_num = <0x4e>;
			r_profile_t0 = <0x437 0x112e 0x437 0x1126 0x43c 0x1110 0x432 0x10fa 0x423 0x10e5 0x415 0x10d2 0x408 0x10c0 0x3fb 0x10ae 0x3ef 0x109d 0x3e3 0x108c 0x3df 0x107d 0x3d6 0x106c 0x3ce 0x105d 0x3c9 0x104e 0x3c1 0x103f 0x3b9 0x1030 0x3b1 0x1021 0x3b1 0x1016 0x3b9 0x100b 0x3bb 0xffe 0x3b3 0xfed 0x3a0 0xfd8 0x389 0xfc1 0x371 0xfab 0x360 0xf98 0x355 0xf89 0x34e 0xf7c 0x34b 0xf70 0x34b 0xf67 0x34b 0xf5e 0x348 0xf54 0x344 0xf4a 0x341 0xf40 0x33f 0xf36 0x33e 0xf2d 0x33d 0xf25 0x33d 0xf1c 0x33f 0xf15 0x33f 0xf0e 0x341 0xf07 0x345 0xf01 0x346 0xefb 0x349 0xef4 0x34c 0xeef 0x34f 0xeea 0x352 0xee6 0x359 0xee2 0x35f 0xedf 0x368 0xedc 0x373 0xed9 0x37c 0xed7 0x38b 0xed5 0x39c 0xed2 0x3af 0xecf 0x3c6 0xecc 0x3df 0xec9 0x3fc 0xec5 0x420 0xec2 0x43c 0xebd 0x462 0xeb7 0x489 0xeb1 0x4b1 0xeaa 0x4d9 0xea3 0x502 0xe9c 0x52b 0xe95 0x556 0xe8f 0x582 0xe89 0x5b2 0xe84 0x5e4 0xe7e 0x615 0xe79 0x64b 0xe71 0x67f 0xe67 0x691 0xe58 0x66b 0xe49 0x642 0xe39 0x618 0xe28 0x5ec 0xe16 0x5bf 0xd48>;
			r_profile_t1_num = <0x4e>;
			r_profile_t1 = <0x1c3 0x1122 0x1c3 0x1111 0x1cf 0x1100 0x1cd 0x10f0 0x1ca 0x10e0 0x1bf 0x10d0 0x1b7 0x10c0 0x1b5 0x10b1 0x1b2 0x10a2 0x1ae 0x1093 0x1ac 0x1084 0x1a8 0x1076 0x1a8 0x1068 0x176 0x105a 0x181 0x104e 0x1a0 0x103f 0x19f 0x1031 0x1a1 0x1023 0x1a5 0x1018 0x19b 0x1007 0x19b 0xffa 0x1a6 0xff0 0x1b1 0xfe5 0x1b9 0xfd8 0x1a5 0xfc6 0x1a0 0xfaf 0x18e 0xf98 0x180 0xf84 0x176 0xf74 0x16e 0xf67 0x16b 0xf5c 0x16a 0xf53 0x168 0xf49 0x115 0xf40 0x15d 0xf36 0x163 0xf2f 0x15b 0xf23 0x159 0xf1a 0x159 0xf13 0x15c 0xf0a 0x15f 0xf04 0x15f 0xefd 0x15e 0xef6 0x15e 0xef0 0x162 0xeea 0x162 0xee5 0x162 0xedf 0x168 0xeda 0x16b 0xed5 0x16b 0xed0 0x16c 0xecc 0x16e 0xec8 0x171 0xec4 0x171 0xec1 0x174 0xebe 0x17b 0xebc 0x181 0xeb9 0x188 0xeb6 0x190 0xeb2 0x198 0xead 0x1a5 0xea8 0x1b2 0xea1 0x1c2 0xe98 0x1d3 0xe8e 0x1e3 0xe84 0x1f5 0xe7b 0x20b 0xe75 0x226 0xe71 0x24a 0xe6e 0x274 0xe6a 0x2a9 0xe66 0x2de 0xe5a 0x310 0xe40 0x342 0xe12 0x383 0xdcf 0x3ef 0xd6c 0x39a 0xd48 0x39a 0xd48>;
			r_profile_t2_num = <0x4e>;
			r_profile_t2 = <0x90 0x1124 0x74 0x1115 0x74 0x1107 0x75 0x10fa 0x74 0x10ea 0x76 0x10db 0x76 0x10cc 0x76 0x10bd 0x77 0x10ae 0xaa 0x109f 0xad 0x1090 0xac 0x1081 0xad 0x1073 0xe2 0x1064 0xe2 0x1056 0xe4 0x1048 0xe9 0x103a 0xeb 0x102b 0xed 0x101e 0xed 0x1010 0xef 0x1002 0xf0 0xff5 0xf9 0xfed 0xfe 0xfe3 0xfa 0xfd0 0xfa 0xfbc 0x100 0xfad 0x104 0xfa2 0x105 0xf99 0x101 0xf8c 0xf8 0xf7d 0xf1 0xf6e 0x118 0xf5f 0x113 0xf51 0x10e 0xf46 0x10d 0xf3c 0x10c 0xf34 0x10c 0xf2b 0x10c 0xf23 0x10e 0xf1c 0x110 0xf16 0x111 0xf0f 0x114 0xf09 0x114 0xf03 0x117 0xefd 0x117 0xef8 0x119 0xef3 0x119 0xeed 0x11a 0xee8 0x11a 0xee3 0x11b 0xede 0x11b 0xeda 0x11c 0xed5 0x11c 0xed0 0x116 0xeca 0x116 0xec5 0x115 0xebf 0x112 0xeb8 0x111 0xeb2 0x112 0xeac 0x116 0xea6 0x113 0xe9b 0x113 0xe91 0x115 0xe85 0x10d 0xe7a 0x10d 0xe77 0x114 0xe76 0x11b 0xe75 0x123 0xe74 0x129 0xe71 0x12b 0xe69 0x122 0xe42 0x12c 0xe10 0x13b 0xdde 0x15c 0xd84 0x192 0xd84 0x142 0xd84 0x142 0xd84>;
			r_profile_t3_num = <0x4e>;
			r_profile_t3 = <0x90 0x111f 0x61 0x1111 0x69 0x1106 0x62 0x10f8 0x65 0x10ea 0x61 0x10dc 0x66 0x10ce 0x66 0x10bf 0x66 0x10b0 0x68 0x10a1 0x67 0x1091 0x6a 0x1083 0x6a 0x1074 0x6d 0x1065 0x6c 0x1057 0x6e 0x1048 0x73 0x1039 0x70 0x102b 0x71 0x101d 0x73 0x100f 0x74 0x1001 0x75 0xff3 0x77 0xfe6 0x78 0xfd9 0x7a 0xfcc 0x7b 0xfbf 0x7d 0xfb3 0x7f 0xfa7 0x82 0xf9c 0x84 0xf91 0x85 0xf85 0x88 0xf7a 0x89 0xf6e 0x84 0xf60 0x79 0xf4f 0x6e 0xf3f 0x69 0xf33 0x67 0xf29 0x66 0xf20 0x67 0xf18 0x67 0xf10 0x6a 0xf09 0x6b 0xf02 0x6d 0xefc 0x70 0xef6 0x6f 0xeef 0x73 0xeea 0x74 0xee4 0x76 0xedf 0x78 0xeda 0x78 0xed5 0x79 0xed1 0x7b 0xecc 0x78 0xec7 0x72 0xebf 0x6b 0xeb6 0x6d 0xeb0 0x67 0xeaa 0x6e 0xea4 0x6e 0xe9d 0x6d 0xe97 0x6d 0xe91 0x6d 0xe8a 0x6c 0xe80 0x6b 0xe76 0x6b 0xe6a 0x65 0xe5f 0x67 0xe5d 0x6b 0xe5c 0x70 0xe5b 0x74 0xe5a 0x77 0xe57 0x71 0xe49 0x77 0xe1e 0x7c 0xddf 0x82 0xd85 0x95 0xd48 0x95 0xd48>;
};
