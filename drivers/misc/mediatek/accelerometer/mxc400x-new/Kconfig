## drivers/misc/mediatek/accelerometer/mxc400x-new/Kconfig
```kconfig
config MTK_MXC400X_NEW
	bool "MXC400X_NEW for MediaTek package"
	default n
	help
	  It support different accelerometer sensor.
          If this option is set,
	  it will support
          MXC400X_NEW Accelerometer.
```

## drivers/misc/mediatek/alsps/epl259x/Kconfig
```kconfig
config MTK_EPL259X
	bool "MTK_EPL259X for MediaTek package"
	default n
	help
	It support different type sensor
	in this platform. If this option
	is set, it will support ambient
	and light sensor MTK_EPL259X.
```
